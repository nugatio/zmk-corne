/*
CONFIG

keyboard: corne (https://github.com/foostan/crkbd)
firmware: zmk (https://zmk.dev/)
layout: hands down (https://sites.google.com/alanreiser.com/handsdown/)

nb@2026.05.30
*/


// ////////// IMPORTS //////////

// default
#include <behaviors.dtsi>
#include <dt-bindings/zmk/bt.h>
#include <dt-bindings/zmk/keys.h>

// other
#include "settings.dtsi"   // settings
#include "positions.dtsi"  // positions


// ////////// DEFINITION //////////

/ {
#include "combos.dtsi"     // combos
#include "behaviors.dtsi"  // behaviors
#include "macros.dtsi"     // macros
#include "keymap.dtsi"     // keymap
};
