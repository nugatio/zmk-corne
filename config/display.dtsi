/*
DISPLAY

keyboard: corne (https://github.com/foostan/crkbd)
firmware: zmk (https://zmk.dev/)
nugatio@2024.09.20 (https://github.com/nugatio/zmk-corne-config)
*/


// IMPORTS

// image
#include "my_image.c"


// DEFINITION

// right image
cfb_framebuffer_set_image(dev, my_image, x_pos, y_pos);
cfb_framebuffer_finalize(dev);
