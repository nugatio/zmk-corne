## config/west.yml
```yaml
# WEST
#
# keyboard: corne (https://github.com/foostan/crkbd)
# firmware: zmk (https://zmk.dev/)
# layout: hands down (https://sites.google.com/alanreiser.com/handsdown/)
#
# nb@2026.05.30

manifest:
  remotes:
    - name: zmkfirmware
      url-base: https://github.com/zmkfirmware
  projects:
    - name: zmk
      remote: zmkfirmware
      revision: main
      import: app/west.yml
  self:
    path: config
```
