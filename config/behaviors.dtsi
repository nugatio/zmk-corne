/*
BEHAVIORS

keyboard: corne (https://github.com/foostan/crkbd)
firmware: zmk (https://zmk.dev/)
nugatio@2024.09.20 (https://github.com/nugatio/zmk-corne-config)
*/


// MACROS

#define MODMORPH(REFERENCE, NAME, BINDINGA, BINDINGB, MODS) \
    m##REFERENCE: modmorph_##NAME { \
        compatible = "zmk,behavior-mod-morph"; \
        #binding-cells = <0>; \
        bindings = <BINDINGA>, <BINDINGB>; \
        mods = <MODS>; \
    };


// OVERVIEW

/* key position names (defined in positions.dtsi)
    ╭─────────────────────╮ ╭─────────────────────╮
LT5 │ LT4 LT3 LT2 LT1 LT0 │ │ RT0 RT1 RT2 RT3 RT4 │ RT5
LM5 │ LM4 LM3 LM2 LM1 LM0 │ │ RM0 RM1 RM2 RM3 RM4 │ RM5
LB5 │ LB4 LB3 LB2 LB1 LB0 │ │ RB0 RB1 RB2 RB3 RB4 │ RB5
    ╰───────╮ LH3 LH2 LH1 │ │ RH1 RH2 RH3 ╭───────╯
            ╰─────────────╯ ╰─────────────╯
*/


// DEFINITION

behaviors {
    hm: homerow_mods {
        compatible = "zmk,behavior-hold-tap";
        #binding-cells = <2>;
        tapping-term-ms = <HOMEROW_TAPPING_TERM>;
        quick-tap-ms = <0>;
        flavor = "tap-preferred";
        bindings = <&kp>, <&kp>;
    };

// modmorphs
MODMORPH(seq,  shift_excl_qmrk,  &kp EXCL,      &kp QMARK,    (MOD_LSFT | MOD_RSFT))
MODMORPH(sfs,  shift_fslh_star,  &kp FSLH,      &kp STAR,     (MOD_LSFT | MOD_RSFT))
MODMORPH(shd,  shift_hash_dllr,  &kp HASH,      &kp DLLR,     (MOD_LSFT | MOD_RSFT))
MODMORPH(scs,  shift_comma_semi, &kp COMMA,     &kp SEMI,     (MOD_LSFT | MOD_RSFT))
MODMORPH(smp,  shift_minus_plus, &kp MINUS,     &kp PLUS,     (MOD_LSFT | MOD_RSFT))
MODMORPH(sdc,  shift_dot_colon,  &kp DOT,       &kp COLON,    (MOD_LSFT | MOD_RSFT))
MODMORPH(sds,  shift_dqt_sqt,    &kp DQT,       &kp SQT,      (MOD_LSFT | MOD_RSFT))
MODMORPH(svup, shift_volup_prev, &kp C_VOL_UP,  &kp C_PREV,   (MOD_LSFT | MOD_RSFT))
MODMORPH(svmp, shift_volmute_pp, &kp C_MUTE,    &kp C_PP,     (MOD_LSFT | MOD_RSFT))
MODMORPH(svdn, shift_voldn_next, &kp C_VOL_DN,  &kp C_NEXT,   (MOD_LSFT | MOD_RSFT))
MODMORPH(sbb,  shift_bspc_sbspc, &lt NPFN BSPC, &kp LA(BSPC), (MOD_LSFT | MOD_RSFT))
};
